## boards/dsy/CachexiaBoardIt2/Kconfig.defconfig
```kconfig
if BOARD_CACHEXIABOARDIT2

config BT_CTLR
	default BT

endif # BOARD_CACHEXIABOARDIT2
```

## boards/dsy/MechanicalSensor/Kconfig.defconfig
```kconfig
if BOARD_MECHANICALSENSOR

config BT_CTLR
	default BT

endif # BOARD_MECHANICALSENSOR
```
